/dts-v1/;
/plugin/;

/ {
	compatible = "drobot,s100-rdk";

	fragment@0 {
		target = <&spi0>;

		__overlay__ {
			#address-cells = <1>;
			#size-cells = <0>;

			spidev@1 {
				compatible = "rohm,dh2228fv";
				reg = <1>;
				spi-max-frequency = <10000000>;
				status = "okay";
			};
		};
	};
};
